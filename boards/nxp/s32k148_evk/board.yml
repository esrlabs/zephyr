## boards/nxp/s32k148_evk/board.yml
```yaml
board:
  name: s32k148_evk
  full_name: S32K148EVB-Q176
  vendor: nxp
  socs:
    - name: s32k148
```

## boards/shields/nxp_adtja1101/Kconfig.defconfig
```kconfig
# Copyright 2024 NXP
# SPDX-License-Identifier: Apache-2.0

config PHY_TJA11xx
    default y
```
